## Kconfig
```kconfig
config FINGERPRINT_XIAOMI_FP
	tristate "Finger print card xiaomi_fp"
	default n
	depends on INPUT_FINGERPRINT
	help
	  Say Y here to enable support for retrieving self-test reports.
	  If unsure, say N.
	  To compile this driver as a module, choose M here.

config TOUCHSCREEN_XIAOMI_TOUCHFEATURE
	tristate "Xiaomi touch driver"
	default m
	help
	  Say Y here if you use xiaomi touch driver.
	  If unsure, say N.
```
